## Documentation/devicetree/bindings/interconnect/qcom-msm8916.txt
```
Qualcomm MSM8916 Network-On-Chip interconnect driver binding
----------------------------------------------------

Required properties :
- compatible : shall contain only one of the following:
			"qcom,msm8916-bimc"
			"qcom,msm8916-pnoc"
			"qcom,msm8916-snoc"
- #interconnect-cells : should contain 1
- reg : shall contain base register location and length

Optional properties :
clocks : list of phandles and specifiers to all interconnect bus clocks
clock-names : clock names should include both "bus_clk" and "bus_a_clk"

Examples:

		snoc: snoc@580000 {
			compatible = "qcom,msm8916-snoc";
			#interconnect-cells = <1>;
			reg = <0x580000 0x14000>;
			clock-names = "bus_clk", "bus_a_clk";
			clocks = <&rpmcc RPM_SMD_SNOC_CLK>,
				 <&rpmcc RPM_SMD_SNOC_A_CLK>;
		};
		bimc: bimc@400000 {
			compatible = "qcom,msm8916-bimc";
			#interconnect-cells = <1>;
			reg = <0x400000 0x62000>;
			clock-names = "bus_clk", "bus_a_clk";
			clocks = <&rpmcc RPM_SMD_BIMC_CLK>,
				 <&rpmcc RPM_SMD_BIMC_A_CLK>;
		};
		pnoc: pnoc@500000 {
			compatible = "qcom,msm8916-pnoc";
			#interconnect-cells = <1>;
			reg = <0x500000 0x11000>;
			clock-names = "bus_clk", "bus_a_clk";
			clocks = <&rpmcc RPM_SMD_PCNOC_CLK>,
				 <&rpmcc RPM_SMD_PCNOC_A_CLK>;
		};
```

## Documentation/devicetree/bindings/interconnect/qcom-smd.txt
```
Qualcomm SMD-RPM interconnect driver binding
------------------------------------------------
The RPM (Resource Power Manager) is a dedicated hardware engine
for managing the shared SoC resources in order to keep the lowest
power profile. It communicates with other hardware subsystems via
the shared memory driver (SMD) back-end and accepts requests for
various resources.

Required properties :
- compatible : shall contain only one of the following:
			"qcom,interconnect-smd-rpm"

Example:
	smd {
		compatible = "qcom,smd";

		rpm {
			interrupts = <GIC_SPI 168 IRQ_TYPE_EDGE_RISING>;
			qcom,ipc = <&apcs 8 0>;
			qcom,smd-edge = <15>;

			rpm_requests {
				compatible = "qcom,rpm-msm8916";
				qcom,smd-channels = "rpm_requests";

				interconnect-smd-rpm {
					compatible = "qcom,interconnect-smd-rpm";
				};

			};
		};
	};
```

## drivers/interconnect/qcom/Kconfig
```kconfig
config INTERCONNECT_QCOM
	bool "Qualcomm Network-on-Chip interconnect drivers"
	depends on ARCH_QCOM
	help
	  Support for Qualcomm's Network-on-Chip interconnect hardware.

config INTERCONNECT_QCOM_SMD_RPM
	tristate "Qualcomm SMD RPM interconnect driver"
	depends on INTERCONNECT_QCOM
	depends on QCOM_SMD_RPM
	help
	  This is a driver for communicating interconnect related configuration
	  details with a remote processor (RPM) on Qualcomm platforms.

config INTERCONNECT_QCOM_MSM8916
	tristate "Qualcomm MSM8916 interconnect driver"
	depends on INTERCONNECT_QCOM
	depends on QCOM_SMD_RPM
	select INTERCONNECT_QCOM_SMD_RPM
	help
	  This is a driver for the Qualcomm Network-on-Chip on msm8916-based
	  platforms.
```

## drivers/ntb/hw/Kconfig
```kconfig
source "drivers/ntb/hw/amd/Kconfig"
source "drivers/ntb/hw/intel/Kconfig"
source "drivers/ntb/hw/mscc/Kconfig"
```

## kunit/Kconfig
```kconfig
#
# KUnit base configuration
#

menu "KUnit support"

config KUNIT
	bool "Enable support for unit tests (KUnit)"
	help
	  Enables support for kernel unit tests (KUnit), a lightweight unit
	  testing and mocking framework for the Linux kernel. These tests are
	  able to be run locally on a developer's workstation without a VM or
	  special hardware. For more information, please see
	  Documentation/kunit/

config KUNIT_TEST
	bool "KUnit test for KUnit"
	depends on KUNIT
	help
	  Enables KUnit test to test KUnit.

config KUNIT_EXAMPLE_TEST
	bool "Example test for KUnit"
	depends on KUNIT
	help
	  Enables example KUnit test to demo features of KUnit.

endmenu
```
